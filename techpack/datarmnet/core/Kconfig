## techpack/datarmnet/core/Kconfig
```kconfig
#
# RMNET MAP driver
#

menuconfig RMNET_CORE
	tristate "Qualcomm RMNET MAP data path"
	depends on NET && INET && QCOM_QMI_HELPERS && !RMNET
	select GRO_CELLS
	---help---
	  If you select this, you will enable the RMNET module which is used
	  for handling data in the multiplexing and aggregation protocol (MAP)
	  format in the embedded data path. RMNET devices can be attached to
	  any IP mode physical device.

menuconfig RMNET_CTL
	tristate "Qualcomm RMNET IPA control channel"
	depends on RMNET_CORE && IPA3
	---help---
	  Enable the RMNET CTL module which is used for handling QMAP commands
	  for flow control purposes.
```
